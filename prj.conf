## CMakeLists.txt
```
cmake_minimum_required(VERSION 3.8.2)

if (CMAKE_BUILD_TYPE STREQUAL "LTE")
  set(CONF_FILE "${CMAKE_CURRENT_SOURCE_DIR}/CONFIGS/LTE.conf")
elseif (CMAKE_BUILD_TYPE STREQUAL "LTE_DEBUG")
  set(CONF_FILE "${CMAKE_CURRENT_SOURCE_DIR}/CONFIGS/LTE_DEBUG.conf")
elseif (CMAKE_BUILD_TYPE STREQUAL "NBIOT")
  set(CONF_FILE "${CMAKE_CURRENT_SOURCE_DIR}/CONFIGS/NBIOT.conf")
elseif (CMAKE_BUILD_TYPE STREQUAL "NBIOT_DEBUG")
  set(CONF_FILE "${CMAKE_CURRENT_SOURCE_DIR}/CONFIGS/NBIOT_DEBUG.conf")
endif()


# This sample is only compatible with ruuvi_node because it has
# re-directed the 'boards' directory to a directory that only contains
# this board.
#set(BOARD_ROOT ${CMAKE_CURRENT_LIST_DIR})
# Will be replaced with Ruuvi Node
set(BOARD nrf9160dk_nrf9160ns)

find_package(Zephyr REQUIRED HINTS $ENV{ZEPHYR_BASE})
project(ruuvi.node_nrf91.c)
zephyr_compile_definitions(PROJECT_NAME=${PROJECT_NAME})
zephyr_compile_definitions(_POSIX_C_SOURCE=200809L)

target_sources(app PRIVATE src/main.c)
zephyr_include_directories(
  src
  components/ruuvi.endpoints.c)

# Include application events and configuration headers
zephyr_library_include_directories(
  src/adv_post
  src/api
  src/led_controller
  src/uart_controller
  src/http_controller
  src/watchdog
  src/time_handler
  src/gps_controller
  )

add_subdirectory(src/adv_post)
add_subdirectory(src/api)
add_subdirectory(src/led_controller)
add_subdirectory(src/uart_controller)
add_subdirectory(src/gps_controller)
add_subdirectory(src/http_controller)   
add_subdirectory(src/time_handler)
add_subdirectory(src/watchdog)
add_subdirectory(components/ruuvi.endpoints.c)
```

## Kconfig
```
#
# Copyright (c) 2018 Nordic Semiconductor ASA
#
# SPDX-License-Identifier: LicenseRef-BSD-5-Clause-Nordic
#

menu "Ruuvi Node"


config APPLICATION_WORKQUEUE_STACK_SIZE
	int "Application workqueue stack size"
	default 2048

config APPLICATION_WORKQUEUE_PRIORITY
	int "Application workqueue priority"
	default SYSTEM_WORKQUEUE_PRIORITY

menu "GPS"

choice
	prompt "GPS device"
	default GPS_USE_SIM
	help
	  Select from which device GPS data will be fetched.

config GPS_USE_SIM
	bool "Use GPS simulator"
	select GPS_SIM
	select GPS_SIM_TRIGGER
	help
	  Use simulated GPS data.

config GPS_USE_EXTERNAL
	bool "User provided GPS device"
	help
	  Provide a GPS device that location data will be fetched from and
	  sent to nRF Cloud

endchoice

config GPS_DEV_NAME
	string "GPS device name"
	default GPS_SIM_DEV_NAME if GPS_USE_SIM
	help
	  GPS device from which location data will be fetched and sent
	  to nRF Cloud.

config GPS_CONTROL_ON_LONG_PRESS
	bool "Control the GPS state with button"
	default y
	help
	  Control the GPS operation with long-press on the button.
	  Press for 5 seconds to enable, or 5 seconds to disable.

config GPS_CONTROL_PSM_ENABLE_ON_START
	bool "Enable PSM when starting GPS"
	help
	  The nRF9160 modem needs to be set in PSM mode for the GPS to start
	  searching for satellites. Enabling this option will do so
	  automatically, otherwise the application must handle it.

config GPS_CONTROL_PSM_DISABLE_ON_STOP
	bool "Disable PSM when stopping GPS"
	help
	  Selecting this option will disable PSM when the GPS is stopped.
	  During a PSM interval, the device is not reachable from the outside
	  until the interval times out, or the device itself attempts to
	  send data on the link.

config GPS_CONTROL_FIRST_FIX_CHECK_DELAY
	int "Time from Cloud conenction until first fix check"
	default 30
	help
	  The amount of time that should pass between successfully establishing
	  connection to cloud until first attempt to get position fix.
	  Attempting to get a fix means entering PSM mode, in which the device
	  is not reachable for the duration of the interval, or until the
	  device itself sends data and then for the duration for the set
	  active time thereafter.

config GPS_CONTROL_FIX_CHECK_INTERVAL
	int "Interval in seconds to between check for position fix"
	default 120
	help
	  The fix check interval gives the interval for how long it will go
	  between each retry to achieve position fix. The actual fix time will
	  vary with factors such as satellite coverage, surrounding buildings
	  and landscape, PSM interval and activity time requested and granted
	  by the network.

config GPS_CONTROL_FIX_CHECK_OVERDUE
	int "Longest allowed time in seconds between checks for position fix"
	default 900
	help
	  The fix check interval gives the interval for how long it will go
	  between each retry to achieve position fix, when GPS_START_ON_MOTION
	  enabled, even if no motion is detected.

config GPS_CONTROL_FIX_TRY_TIME
	int "Time in seconds to try to get fix"
	default 180
	help
	  Amount of time the device will attempt to get position fix. Note that
	  if the interval is interrupted by the device sending data, the timer
	  is not reset, and the actual try time will be shortened due to
	  the device not being in PSM mode all the time. If fix is not acquired
	  before it times out, the device will try to get fix again in
	  GPS_CONTROL_FIX_CHECK_INTERVAL seconds. If GPS_CONTROL_FIX_COUNT is reached
	  before the full GPS_CONTROL_FIX_TRY_TIME has passed, the GPS will be stopped.

config GPS_CONTROL_FIX_COUNT
	int "Number of position fix before stopping GPS"
	default 3
	help
	  The number of fixes to get before stopping the GPS, within the time
	  set in GPS_CONTROL_FIX_CHECK_INTERVAL.

config GPS_CONTROL_MAX_FAILED_FIX_ATTEMPTS
	int "Number of failed fix attempts before stopping GPS"
	default 3
	help
	  Number of retries to get fix before shutting down the GPS until user
	  input tells it to start retrying.

config GPS_START_ON_MOTION
	bool "Motion triggered GPS update"
	default n
	help
	  When accelerometer detects movement, and GPS is enabled, update GPS
	  position, but if no movement, wait a longer delay between updates
	  to conserve power.

endmenu # GPS

menu "Device and modem"

config POWER_OPTIMIZATION_ENABLE
	bool "Enable power optimization"
	default y
	select LTE_EDRX_REQ

if MODEM_INFO

config HOLD_TIME_RSRP
	int "Minimum time [s] between RSRP subscription messages"
	default 60
	help
	  The minimum time in seconds where the modem
	  informer is allowed to submit RSRP data to the cloud.

endif

endmenu # Device

menu "Firmware versioning"

config RUUVI_NODE_APP_VERSION
	string "The version of the Ruuvi Node firmware"
	default "0.0.0-development"

endmenu # Firmware versioning

menu "Ruuvi Endpoint"

config RUUVI_ENDPOINT_HTTPS
	int "Enable HTTPS"
	default 1

config RUUVI_ENDPOINT_HTTP_PORT
	int "HTTP Port to use"
	default 80

config RUUVI_ENDPOINT_HTTPS_PORT
	int "HTTPS Port to use"
	default 443

config RUUVI_ENDPOINT_HOST
	string "The domain of the ruuvi endpoint"
	default "ruuvi.cloud"

config RUUVI_ENDPOINT_HOST_PATH
	string "The end of the POST url"
	default "/ruuvi-node"

endmenu # Ruuvi Endpoint

config RUUVI_WATCHDOG_TIMEOUT_MSEC
	int "Watchdog timeout in milliseconds"
	default 10000

config RUUVI_GPS_UPDATE_INT
	int "Update GPS position after x minutes"
	default 60

config RUUVI_GPS_FAILED_RETRY
	int "Reattempt to gain a GPS position after x minutes"
	default 5

config USE_AT_HOST
	bool "Enable AT commands"
	default y
	select AT_HOST_LIBRARY
	help
	  Enable the AT host library so that AT commands can be sent to and
	  received from a serial terminal.

endmenu

menu "Zephyr Kernel"
source "Kconfig.zephyr"
endmenu

module = RUUVI_NODE
module-str = Ruuvi Node
source "${ZEPHYR_BASE}/subsys/logging/Kconfig.template.log_config"
```

## sample.yaml
```
sample:
  name: Ruuvi Node
tests:
  test_build:
    build_only: true
    build_on_all: true
    platform_whitelist: nrf9160_pca10090ns nrf52_pca10040
    tags: ci_build
```

## west.yml
```
manifest:
  defaults:
    remote: ruuvi

  remotes:
    - name: ruuvi
      url-base: https://github.com/ruuvi
    - name: ncs
      url-base: https://github.com/NordicPlayground
    - name: zephyrproject
      url-base: https://github.com/zephyrproject-rtos
    - name: throwtheswitch
      url-base: https://github.com/ThrowTheSwitch
    - name: armmbed
      url-base: https://github.com/ARMmbed
    - name: civetweb
      url-base: https://github.com/civetweb
    
  projects:
    - name: zephyr
      repo-path: fw-nrfconnect-zephyr
      remote: ncs
      west-commands: scripts/west-commands.yml
      revision: 43f55fa7be2c86116af78e0a60486e5131b16ea1
    - name: ncs
      repo-path: fw-nrfconnect-nrf
      remote: ncs
      path: nrf
      revision: v1.2.0
    - name: segger
      revision: 6fcf61606d6012d2c44129edc033f59331e268bc
      path: modules/debug/segger
      remote: zephyrproject
    - name: mbedtls
      path: modules/crypto/mbedtls
      revision: 3776c158fe138a72c97c187e4d31c81c37884be9
      remote: zephyrproject
    - name: mcuboot
      remote: ncs
      repo-path: fw-nrfconnect-mcuboot
      revision: d0c2fbefd26e830ddff08b3060d7f16af5eccd26
      path: bootloader/mcuboot
    - name: mcumgr
      remote: ncs
      repo-path: fw-nrfconnect-mcumgr
      revision: 1afd6bbbfed0137b3156349f968634bbd8fc6fff
      path: modules/lib/mcumgr
    - name: tinycbor
      path: modules/lib/tinycbor
      revision: 0fc68fceacd1efc1ce809c5880c380f3d98b7b6e
      remote: zephyrproject
    - name: ci-tools
      path: tools/ci-tools
      remote: zephyrproject
      revision: e869d2524d1344d80063bf2898095faf9228f7b5
    - name: net-tools
      path: tools/net-tools
      remote: zephyrproject
      revision: 30b7efa827b04d2e47840716b0372737fe7d6c92
    - name: nrfxlib
      remote: ncs
      path: nrfxlib
      revision: 1e8b3eef2566a5670861c66a760e20742ead72d4
    - name: cmock
      path: test/cmock
      revision: c243b9a7a7b3c471023193992b46cf1bd1910450
      remote: throwtheswitch
    - name: unity
      path: test/cmock/vendor/unity
      revision: 031f3bbe45f8adf504ca3d13e6f093869920b091
      remote: throwtheswitch
    - name: mbedtls-nrf
      path: mbedtls
      repo-path: mbedtls
      revision: mbedtls-2.16.4
      remote: armmbed
    - name: civetweb
      path: modules/lib/civetweb
      remote: civetweb
      revision: 99129c5efc907ea613c4b73ccff07581feb58a7a
    - name: edtt
      path: tools/edtt
      remote: zephyrproject
      revision: dd4dd502ef2fbeced6ef7faaba562a7ddca45632
    - name: fatfs
      path: modules/fs/fatfs
      remote: zephyrproject
      revision: 9ee6b9b9511151d0d64a74d532d39c6f2bbd4f16
    - name: hal_nordic
      path: modules/hal/nordic
      remote: zephyrproject
      revision: 12d7647870888e4cb0e421f2b26884c2e76915ac
    - name: hal_st
      path: modules/hal/st
      remote: zephyrproject
      revision: fa481784b3c49780f18d50bafe00390ccb62b2ec
    - name: libmetal
      path: modules/hal/libmetal
      remote: zephyrproject
      revision: 45e630d6152824f807d3f919958605c4626cbdff
    - name: loramac-node
      path: modules/lib/loramac-node
      remote: zephyrproject
      revision: 29e516ec585b1a909af2b5f1c60d83e7d4d563e3
    - name: lvgl
      path: modules/lib/gui/lvgl
      remote: zephyrproject
      revision: 74fc2e753a997bd71cefa34dd9c56dcb954b42e2
    - name: nrf_hw_models
      path: modules/bsim_hw_models/nrf_hw_models
      remote: zephyrproject
      revision: fec69703cb1ca06fcdab6d5fde01274f0fc5c759
    - name: open-amp
      path: modules/lib/open-amp
      remote: zephyrproject
      revision: 9b591b289e1f37339bd038b5a1f0e6c8ad39c63a
    - name: openthread
      path: modules/lib/openthread
      remote: zephyrproject
      revision: 3c6191eb4e8ca44b5f4eeaa696837bce14e83c69
    - name: littlefs
      path: modules/fs/littlefs
      remote: zephyrproject
      revision: fe9572dd5a9fcf93a249daa4233012692bd2881d
    - name: mipi-sys-t
      path: modules/debug/mipi-sys-t
      remote: zephyrproject
      revision: baf51863f19f009b92e762115ba5572a5b996b92
    - name: canopennode
      path: modules/lib/canopennode
      remote: zephyrproject
      revision: 5c6b0566d56264efd4bf23ed58bc7cb8b32fe063
  
  self:
    path: ruuvi_node
```

## prj.conf
```kconfig
#Ruuvi
CONFIG_RUUVI_GPS_UPDATE_INT=30
CONFIG_RUUVI_ENDPOINT_HTTPS=y
CONFIG_RUUVI_ENDPOINT_HOST="webhook.site"
CONFIG_RUUVI_ENDPOINT_HOST_PATH="/d9b16e2e-1ef1-4eee-b90f-399a70b398a9"

# Peripherals
CONFIG_GPIO=y
CONFIG_SERIAL=y
CONFIG_UART_INTERRUPT_DRIVEN=y
#CONFIG_UART_1_NRF_UARTE=y

# GPS
CONFIG_NRF9160_GPS=y
# CONFIG_GPS_USE_SIM=y

CONFIG_GPS_USE_EXTERNAL=y
CONFIG_GPS_DEV_NAME="NRF9160_GPS"
CONFIG_GPS_CONTROL_PSM_ENABLE_ON_START=y

CONFIG_GPS_CONTROL_FIRST_FIX_CHECK_DELAY=10
CONFIG_GPS_CONTROL_FIX_CHECK_INTERVAL=30
CONFIG_GPS_CONTROL_FIX_TRY_TIME=360
CONFIG_GPS_CONTROL_PSM_DISABLE_ON_STOP=n

# General config
CONFIG_CJSON_LIB=y
CONFIG_NEWLIB_LIBC=y
CONFIG_NEWLIB_LIBC_FLOAT_PRINTF=y
CONFIG_REBOOT=y

# Network
CONFIG_NETWORKING=y
CONFIG_NET_SOCKETS=y
CONFIG_NET_SOCKETS_OFFLOAD=y

# Modem info
CONFIG_MODEM_INFO=y

# BSD library
CONFIG_BSD_LIBRARY=y
CONFIG_BSD_LIBRARY_TRACE_ENABLED=n

# Heap and stacks
CONFIG_HEAP_MEM_POOL_SIZE=16384
CONFIG_MAIN_STACK_SIZE=8192
CONFIG_SYSTEM_WORKQUEUE_STACK_SIZE=2048
CONFIG_HW_STACK_PROTECTION=y

# Fatal error
CONFIG_RESET_ON_FATAL_ERROR=n
CONFIG_WATCHDOG=y
```

## LTE.conf
```kconfig
# LTE link control
CONFIG_POWER_OPTIMIZATION_ENABLE=n
CONFIG_LTE_LINK_CONTROL=y
CONFIG_LTE_NETWORK_MODE_LTE_M_GPS=y
CONFIG_LTE_AUTO_INIT_AND_CONNECT=y
CONFIG_LTE_PSM_REQ_RPTAU="00000110"
CONFIG_LTE_PSM_REQ_RAT="00000010"
```

## LTE_DEBUG.conf
```kconfig
# LTE link control
CONFIG_POWER_OPTIMIZATION_ENABLE=n
CONFIG_LTE_LINK_CONTROL=y
CONFIG_LTE_NETWORK_MODE_LTE_M_GPS=y
CONFIG_LTE_AUTO_INIT_AND_CONNECT=y
CONFIG_LTE_PSM_REQ_RPTAU="00000110"
CONFIG_LTE_PSM_REQ_RAT="00000010"

#Debugging
CONFIG_UART_CONSOLE=y
CONFIG_CONSOLE_SUBSYS=y
CONFIG_CONSOLE_HANDLER=y
CONFIG_CONSOLE_GETCHAR=y
CONFIG_LOG=y
CONFIG_LOG_IMMEDIATE=y

#Module Logging
CONFIG_LTE_LINK_CONTROL_LOG_LEVEL_DBG=n
CONFIG_NRF9160_GPS_LOG_LEVEL_DBG=n
```

## NB-IoT.conf
```kconfig
# LTE link control
CONFIG_POWER_OPTIMIZATION_ENABLE=n
CONFIG_LTE_LINK_CONTROL=y
CONFIG_LTE_AUTO_INIT_AND_CONNECT=y
CONFIG_LTE_LINK_CONTROL_LOG_LEVEL_DBG=y
CONFIG_LTE_NETWORK_MODE_NBIOT_GPS=y
CONFIG_LTE_LEGACY_PCO_MODE=y
CONFIG_LTE_PSM_REQ_RPTAU="00000110"
CONFIG_LTE_PSM_REQ_RAT="00000010"
```

## NB-IoT_DEBUG.conf
```kconfig
# LTE link control
CONFIG_POWER_OPTIMIZATION_ENABLE=n
CONFIG_LTE_LINK_CONTROL=y
CONFIG_LTE_AUTO_INIT_AND_CONNECT=y
CONFIG_LTE_LINK_CONTROL_LOG_LEVEL_DBG=y
CONFIG_LTE_NETWORK_MODE_NBIOT_GPS=y
CONFIG_LTE_LEGACY_PCO_MODE=y
CONFIG_LTE_PSM_REQ_RPTAU="00000110"
CONFIG_LTE_PSM_REQ_RAT="00000010"

#Debugging
CONFIG_UART_CONSOLE=y
CONFIG_CONSOLE_SUBSYS=y
CONFIG_CONSOLE_HANDLER=y
CONFIG_CONSOLE_GETCHAR=y
CONFIG_LOG=y
CONFIG_LOG_IMMEDIATE=y

#Module Logging
CONFIG_LTE_LINK_CONTROL_LOG_LEVEL_DBG=n
CONFIG_NRF9160_GPS_LOG_LEVEL_DBG=n
```

## src/main.c
```c
#include <zephyr.h>
#include <kernel_structs.h>
#include <stdio.h>
#include <string.h>
#include <time.h>
#include <console/console.h>
#include <power/reboot.h>
#include <logging/log_ctrl.h>
#include <drivers/gps.h>

#if defined(CONFIG_BSD_LIBRARY)
#include <modem/bsdlib.h>
#include <bsd.h>
#include <modem/lte_lc.h>
#include <modem/modem_info.h>
#endif /* CONFIG_BSD_LIBRARY */

#if defined(CONFIG_BOOTLOADER_MCUBOOT)
#include <dfu/mcuboot.h>
#endif

#include "api.h"
#include "ruuvi_endpoint_ca_uart.h"
#include "led_controller.h"
#include "uart_controller.h"
#include "gps_controller.h"
#include "http_controller.h"
#include "adv_post.h"
#include "ruuvinode.h"
#include "time_handler.h"
#include "watchdog.h"

#include <logging/log.h>
LOG_MODULE_REGISTER(ruuvi_node, CONFIG_RUUVI_NODE_LOG_LEVEL);

/* scheduling priority used by each thread */
#define PRIORITY 7

#if CONFIG_MODEM_INFO
struct rsrp_data {
	uint16_t value;
	uint16_t offset;
};
static struct k_delayed_work rsrp_work;
static struct rsrp_data rsrp = {
	.value = 0,
	.offset = MODEM_INFO_RSRP_OFFSET_VAL,
};
#endif /* CONFIG_MODEM_INFO */

/* Stack definition for application workqueue */
K_THREAD_STACK_DEFINE(application_stack_area,
		      CONFIG_APPLICATION_WORKQUEUE_STACK_SIZE);
static struct k_work_q application_work_q;

// Sensor data
static atomic_val_t http_post_active;
static time_t gps_last_active_time;
static bool gps_first_fix = false;
static time_t gps_last_update_time;
static struct modem_param_info modem_param;
static char modem_fw_buf[MODEM_FW_LEN + 1];

static void set_gps_enable(const bool enable);
static void sensors_init(void);
static void work_init(void);

static void
shutdown_modem(void)
{
#if defined(CONFIG_LTE_LINK_CONTROL)
	/* Turn off and shutdown modem */
	LOG_ERR("LTE link disconnect");
	int err = lte_lc_power_off();

	if (err) {
		LOG_ERR("lte_lc_power_off failed: %d", err);
	}
#endif /* CONFIG_LTE_LINK_CONTROL */
#if defined(CONFIG_BSD_LIBRARY)
	LOG_ERR("Shutdown modem");
	bsdlib_shutdown();
#endif
}

enum error_type {
	ERROR_CLOUD,
	ERROR_BSD_RECOVERABLE,
	ERROR_LTE_LC,
	ERROR_SYSTEM_FAULT
};

void
error_handler(enum error_type err_type, int err_code)
{
	atomic_set(&http_post_active, 0);
	if (err_type == ERROR_CLOUD) {
		shutdown_modem();
	}

#if !defined(CONFIG_DEBUG) && defined(CONFIG_REBOOT)
	LOG_PANIC();
	sys_reboot(0);
#else
	switch (err_type) {
	case ERROR_BSD_RECOVERABLE:
		LOG_ERR("Error of type ERROR_BSD_RECOVERABLE: %d", err_code);
	break;

		LOG_ERR("Unknown error type: %d, code: %d",
			err_type, err_code);
	break;
	}

	while (true) {
		k_cpu_idle();
	}
#endif /* CONFIG_DEBUG */
}

void
k_sys_fatal_error_handler(unsigned int reason,
			       const z_arch_esf_t *esf)
{
	ARG_UNUSED(esf);

	LOG_PANIC();
	LOG_ERR("Running main.c error handler");
	error_handler(ERROR_SYSTEM_FAULT, reason);
	CODE_UNREACHABLE;
}

/**@brief Recoverable BSD library error. */
void
bsd_recoverable_error_handler(uint32_t err)
{
	error_handler(ERROR_BSD_RECOVERABLE, (int)err);
}

static void
gps_time_set(struct gps_pvt *gps_data)
{
	/* Change datetime.year and datetime.month to accommodate the
	 * correct input format.
	 */
	struct tm gps_time = {
		.tm_year = gps_data->datetime.year - 1900,
		.tm_mon = gps_data->datetime.month - 1,
		.tm_mday = gps_data->datetime.day,
		.tm_hour = gps_data->datetime.hour,
		.tm_min = gps_data->datetime.minute,
		.tm_sec = gps_data->datetime.seconds,
	};

	update_ts_gps(&gps_time);
}

static void
set_gps_enable(const bool enable)
{
	bool changing = (enable != gps_control_is_enabled());

	if (changing) {
		if (enable) {
			LOG_INF("Starting GPS");
		} else {
			LOG_INF("Stopping GPS");
			gps_control_stop(0);
		}
	}
}

static void
gps_handler(const struct device *dev, struct gps_event *evt)
{
	gps_last_active_time = get_ts();
	switch (evt->type) {
	case GPS_EVT_SEARCH_STARTED:
		LOG_INF("GPS_EVT_SEARCH_STARTED");
		gps_control_set_active(true);
		break;
	case GPS_EVT_SEARCH_STOPPED:
		LOG_INF("GPS_EVT_SEARCH_STOPPED");
		gps_control_set_active(false);
		break;
	case GPS_EVT_SEARCH_TIMEOUT:
		LOG_INF("GPS_EVT_SEARCH_TIMEOUT");
		gps_control_set_active(false);
		LOG_INF("GPS will be attempted again in %d minutes",
			CONFIG_RUUVI_GPS_FAILED_RETRY);
		gps_control_stop(0);
		break;
	case GPS_EVT_PVT:
		/* Don't spam logs */
		break;
	case GPS_EVT_PVT_FIX:
		LOG_INF("GPS_EVT_PVT_FIX");
		gps_last_update_time = get_ts();
		gps_first_fix = true;
		update_position_data(evt->pvt.latitude, evt->pvt.longitude);
		gps_time_set(&evt->pvt);
		gps_control_set_active(false);
		LOG_INF("GPS will be started in %d seconds",
			gps_control_get_gps_reporting_interval());
		gps_control_stop(0);
		break;
	case GPS_EVT_NMEA:
		/* Don't spam logs */
		break;
	case GPS_EVT_NMEA_FIX:
		LOG_INF("Position fix with NMEA data");
		break;
	case GPS_EVT_OPERATION_BLOCKED:
		LOG_INF("GPS_EVT_OPERATION_BLOCKED");
		break;
	case GPS_EVT_OPERATION_UNBLOCKED:
		LOG_INF("GPS_EVT_OPERATION_UNBLOCKED");
		break;
	case GPS_EVT_ERROR:
		LOG_INF("GPS_EVT_ERROR\n");
		break;
	default:
		break;
	}
}

/**@brief Configures modem to provide LTE link. Blocks until link is
 * successfully established.
 */
static int
modem_configure(void)
{
#if defined(CONFIG_BSD_LIBRARY)
	if (IS_ENABLED(CONFIG_LTE_AUTO_INIT_AND_CONNECT)) {
		/* Do nothing, modem is already turned on */
		/* and connected */
		goto connected;
	}

	LOG_INF("Connecting to LTE network.");
	LOG_INF("This may take several minutes.");

#if defined(CONFIG_LWM2M_CARRIER)
	/* Wait for the LWM2M carrier library to configure the */
	/* modem and set up the LTE connection. */
	k_sem_take(&lte_connected, K_FOREVER);
#else /* defined(CONFIG_LWM2M_CARRIER) */
	int err = lte_lc_init_and_connect();
	if (err) {
		LOG_ERR("LTE link could not be established.");
		return err;
	}
#endif /* defined(CONFIG_LWM2M_CARRIER) */

connected:
	LOG_INF("Connected to LTE network.");

#endif /* defined(CONFIG_BSD_LIBRARY) */
	return 0;
}

#if CONFIG_MODEM_INFO
/**@brief Callback handler for LTE RSRP data. */
static void
modem_rsrp_handler(char rsrp_value)
{
	/* RSRP raw values that represent actual signal strength are
	 * 0 through 97 (per "nRF91 AT Commands" v1.1). If the received value
	 * falls outside this range, we should not send the value.
	 */
	if (rsrp_value > 97) {
		return;
	}

	rsrp.value = rsrp_value;

	/* Only send the RSRP if transmission is not already scheduled.
	 * Checking CONFIG_HOLD_TIME_RSRP gives the compiler a shortcut.
	 */
	if (CONFIG_HOLD_TIME_RSRP == 0 ||
	    k_delayed_work_remaining_get(&rsrp_work) == 0) {
		k_delayed_work_submit_to_queue(&application_work_q, &rsrp_work,
					       K_NO_WAIT);
	}
}

/**@brief Publish RSRP data to the cloud. */
static void
modem_rsrp_data_print(struct k_work *work)
{
	char buf[CONFIG_MODEM_INFO_BUFFER_SIZE] = {0};
	static int32_t rsrp_prev; /* RSRP value last sent to cloud */
	int32_t rsrp_current;
	size_t len;

	if (atomic_get(&http_post_active) == 0){
		/* The RSRP value is copied locally to avoid any race */
		rsrp_current = rsrp.value - rsrp.offset;

		if (rsrp_current == rsrp_prev) {
			return;
		}

		len = snprintf(buf, CONFIG_MODEM_INFO_BUFFER_SIZE,
				"%d", rsrp_current);

		LOG_INF("RSRP: %d", rsrp_current);

		rsrp_prev = rsrp_current;

		if (CONFIG_HOLD_TIME_RSRP > 0) {
			k_delayed_work_submit_to_queue(&application_work_q, &rsrp_work,
							K_SECONDS(CONFIG_HOLD_TIME_RSRP));
		}
	}
}
#endif


#if CONFIG_MODEM_INFO
/**brief Initialize LTE status containers. */
static void
modem_data_init(void)
{
	int err;
	err = modem_info_init();
	if (err) {
		LOG_ERR("Modem info could not be established: %d", err);
		return;
	}

	modem_info_params_init(&modem_param);

	modem_info_rsrp_register(modem_rsrp_handler);
}
#endif /* CONFIG_MODEM_INFO */

/**@brief Initializes and submits delayed work. */
static void
work_init(void)
{
#if CONFIG_MODEM_INFO
	k_delayed_work_init(&rsrp_work, modem_rsrp_data_print);
#endif /* CONFIG_MODEM_INFO */
}

void
mac_address_bin_init(mac_address_bin_t *p_mac, const uint8_t mac[6])
{
    memcpy(p_mac->mac, mac, sizeof(p_mac->mac));
}

mac_address_str_t
mac_address_to_str(const mac_address_bin_t *p_mac)
{
    mac_address_str_t mac_str = { 0 };
    const uint8_t *   mac     = p_mac->mac;
    snprintf(
        mac_str.str_buf,
        sizeof(mac_str.str_buf),
        "%02X:%02X:%02X:%02X:%02X:%02X",
        mac[0],
        mac[1],
        mac[2],
        mac[3],
        mac[4],
        mac[5]);
    return mac_str;
}

/** @brief Initialises the peripherals that are used by the application. */
static void
sensors_init(void)
{
	//Turns status LEDs on
	led_init();
	led_0_on();
	led_1_on();
	led_2_on();

	while (modem_configure() != 0) {
		LOG_WRN("Failed to establish LTE connection.");
		LOG_WRN("Will retry in %d seconds.", 10);
		k_sleep(K_SECONDS(10));
	}
	led_2_off();

#if CONFIG_MODEM_INFO
	modem_data_init();
	update_imei_data();

	int err = modem_info_string_get(MODEM_INFO_FW_VERSION, modem_fw_buf, sizeof(modem_fw_buf));
	if (err != MODEM_FW_LEN) {
		LOG_ERR("modem_info_string_get(MODEM FW), error: %d", err);
	}
	LOG_INF("Modem FW Version : %s", log_strdup(modem_fw_buf));
#endif /* CONFIG_MODEM_INFO */

	k_sleep(K_SECONDS(2));
	update_ts_modem();
	k_sleep(K_SECONDS(10));

	//GPS
	err = gps_control_init(&application_work_q, gps_handler);
	if (err) {
		LOG_ERR("GPS could not be initialized");
		return;
	}
	else{
		set_gps_enable(true);
		led_0_off();
	}

	// UART
	err = uart_init();
	if(err){
		LOG_ERR("Error: Opening UART device");
	}
	else{
		LOG_INF("UART Init Sucessful");
		led_1_off();
	}

	atomic_set(&http_post_active, 0);
}

void
ruuvi_send_nrf_get_id(void)
{
    api_send_get_device_id(RE_CA_UART_GET_DEVICE_ID);
}

void
main(void)
{
	LOG_INF("Ruuvi Node Started");
	if(CONFIG_RUUVI_NODE_APP_VERSION){
		LOG_INF("Version: %s", log_strdup(CONFIG_RUUVI_NODE_APP_VERSION));
	}

	//Used for GPS Work Handler
	k_work_q_start(&application_work_q, application_stack_area,
		       K_THREAD_STACK_SIZEOF(application_stack_area),
		       CONFIG_APPLICATION_WORKQUEUE_PRIORITY);
	if (IS_ENABLED(CONFIG_WATCHDOG)) {
		watchdog_init_and_start(&application_work_q);
	}

	work_init();

	// Initilise the peripherals
	sensors_init();

	online_post();

	gps_control_start(0);
	
	while(1){
		flash_led(3, 50);
		if (gps_control_is_active()) {
			k_sleep(K_SECONDS(1));
		}
		else{
			if(gps_first_fix && ((get_ts() - gps_last_update_time) / 60) >= CONFIG_RUUVI_GPS_UPDATE_INT){
				gps_control_start(0);
				// Slight delay to allow gps control to become active
				k_sleep(K_SECONDS(1));
			}
			else if(!gps_first_fix && ((get_ts() - gps_last_active_time) / 60) >= CONFIG_RUUVI_GPS_FAILED_RETRY){
				gps_control_start(0);
				// Slight delay to allow gps control to become active
				k_sleep(K_SECONDS(1));
			}
			else{
				atomic_set(&http_post_active, 1);
				adv_post();
				k_sleep(K_SECONDS(30));
			}
		}
		atomic_set(&http_post_active, 0);
	}
}
```

## src/adv_post.c
```c
#include <zephyr.h>
#include <stdio.h>
#include <string.h>
#include <stdbool.h>
#include <ctype.h>
#if defined(CONFIG_BSD_LIBRARY)
#include <modem/modem_info.h>
#endif /* CONFIG_BSD_LIBRARY */

#include "ruuvi_endpoint_ca_uart.h"
#include "ruuvi_endpoints.h"
#include "http_controller.h"
#include "time_handler.h"
#include "ruuvinode.h"
#include "adv_post.h"

#include <logging/log.h>
LOG_MODULE_REGISTER(adv_post, CONFIG_RUUVI_NODE_LOG_LEVEL);

gw_metrics_t gw_metrics = {};
double latT = 0;
double longT = 0;
static char gw_imei_buf[GW_IMEI_LEN + 1];

K_MUTEX_DEFINE(adv_table_mux);

struct adv_report_table adv_reports;
struct adv_report_table adv_reports_buf;

void update_position_data(double latitude, double longitude){
    latT = latitude;
    longT = longitude;
    return;
}

void update_imei_data(void){
    int err = modem_info_string_get(MODEM_INFO_IMEI, gw_imei_buf, sizeof(gw_imei_buf));
	if (err != GW_IMEI_LEN) {
		LOG_ERR("modem_info_string_get(IMEI), error: %d", err);
	}
	LOG_INF("Device IMEI: %s", log_strdup(gw_imei_buf));
}

static int
adv_put_to_table(const adv_report_t *const p_adv)
{
    k_mutex_lock(&adv_table_mux, K_FOREVER);
    gw_metrics.received_advertisements++;
    bool      found = false;
    int ret   = 0;

    // Check if we already have advertisement with this MAC
    for (int i = 0; i < adv_reports.num_of_advs; i++)
    {
        const mac_address_bin_t *p_mac = &adv_reports.table[i].tag_mac;
        if (memcmp(&p_adv->tag_mac, p_mac, sizeof(*p_mac)) == 0)
        {
            // Yes, update data.
            found                = true;
            adv_reports.table[i] = *p_adv;
        }
    }

    // not found from the table, insert if not full
    if (!found)
    {
        if (adv_reports.num_of_advs < MAX_ADVS_TABLE)
        {
            adv_reports.table[adv_reports.num_of_advs++] = *p_adv;
        }
        else
        {
            ret = 101;
        }
    }
    k_mutex_unlock(&adv_table_mux);
    return ret;
}

static bool
is_hexstr(char *str)
{
    for (int i = 0; i < strlen(str); i++)
    {
        if (isxdigit(str[i]) == 0)
        {
            return 102;
        }
    }

    return 0;
}

static int
is_adv_report_valid(adv_report_t *adv)
{
    int err = 0;

    if (is_hexstr(adv->data) != 0)
    {
        err = 102;
    }

    return err;
}

static int to_hex_str(char *out, u16_t out_size, const u8_t *in, u8_t in_size)
{
	int bytes_written = 0;
	int status;
	int i = 0;

	for (; in_size > 0; in_size--) {
		status = snprintf(out + bytes_written,
				  out_size - bytes_written,
				  "%02x",
				  in[i]);
		if (status < 0) {
			return status;
		}

		bytes_written += status;
		i++;
	}

	return bytes_written;
}

static int
parse_adv_report_from_uart(const re_ca_uart_payload_t *const msg, adv_report_t *adv)
{
    int err = 0;

    if (NULL == msg)
    {
        err = 102;
    }
    else if (NULL == adv)
    {
        err = 102;
    }
    else if (msg->cmd != RE_CA_UART_ADV_RPRT)
    {
        err = 102;
    }
    else
    {
        const re_ca_uart_ble_adv_t *const report = &(msg->params.adv);
        time_t now    = get_ts();
        adv->rssi      = report->rssi_db;
        adv->timestamp = now;
        mac_address_bin_init(&adv->tag_mac, report->mac);
        to_hex_str(adv->data, sizeof(adv->data), report->adv, report->adv_len);
        
        if (is_adv_report_valid(adv))
        {
            err = 102;
        }
    }
    return err;
}

static void
adv_post_send_ack(void *arg)
{
    // Do something
}

static void
adv_post_send_device_id(void *arg)
{
    // Do something
}

void
adv_post_send_report(void *arg)
{
    adv_report_t adv_report;
    // Refactor into function
    if (parse_adv_report_from_uart((re_ca_uart_payload_t *)arg, &adv_report) == 0)
    {
        int ret = adv_put_to_table(&adv_report);
        if (ret == 101)
        {
            //LOG_WRN("Adv report table full, adv dropped");
        }
    }
}

void online_post(void){
    http_send_online(gw_imei_buf);
}

void adv_post(void)
{
    adv_report_t *adv = 0;
    LOG_INF("advertisements in table:");

    for (int i = 0; i < adv_reports.num_of_advs; i++)
    {
        adv                             = &adv_reports.table[i];
        const mac_address_str_t mac_str =  mac_address_to_str(&adv->tag_mac);
        LOG_INF("i: %d, tag: %s, rssi: %d, data: %s, timestamp: %lld",
            i,
            mac_str.str_buf,
            adv->rssi,
            adv->data,
            adv->timestamp);
    }

    // for thread safety copy the advertisements to a separate buffer for
    // posting
    k_mutex_lock(&adv_table_mux, K_FOREVER);
    adv_reports_buf         = adv_reports;
    adv_reports.num_of_advs = 0; // clear the table
    k_mutex_unlock(&adv_table_mux);


    if (adv_reports_buf.num_of_advs){
        http_send_advs(&adv_reports_buf, latT, longT, gw_imei_buf);
    }
}
```

## src/adv_post.h
```c
#include <zephyr.h>

void update_position_data(double latitude, double longitude);
void update_imei_data(void);
void adv_post_send_report(void *arg);
void online_post(void);
void adv_post_task(void);
```

## src/ruuvinode.h
```c
#pragma once

#include <zephyr.h>
#include <stdint.h>
#include <stdbool.h>

#define RUUVI_COMPANY_ID 0x0499

#define MAC_LEN 12
#define ADV_DATA_MAX_LEN 64
#define GW_IMEI_LEN 15
#define MODEM_FW_LEN 17
#define MODEM_TIME_LEN 20
#define ADV_POST_INTERVAL 20	//in Seconds
#define MAX_ADVS_TABLE 10

typedef struct mac_address_bin
{
    uint8_t mac[6];
} mac_address_bin_t;

typedef struct mac_address_str
{
    char str_buf[6 * 2 + 5 + 1]; // format: XX:XX:XX:XX:XX:XX
} mac_address_str_t;

typedef struct adv_report
{
    mac_address_bin_t tag_mac;
    time_t            timestamp;
    int               rssi;
    char              data[ADV_DATA_MAX_LEN + 1];
} adv_report_t;

struct adv_report_table
{
    int          num_of_advs;
    adv_report_t table[MAX_ADVS_TABLE];
};

typedef struct gw_metrics
{
    uint64_t received_advertisements;
} gw_metrics_t;

void mac_address_bin_init(mac_address_bin_t *p_mac, const uint8_t mac[6]);

mac_address_str_t mac_address_to_str(const mac_address_bin_t *p_mac);

void ruuvi_send_nrf_get_id(void);
```
